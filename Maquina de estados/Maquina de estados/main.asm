;
; Maquina de estados.asm
;
; Created: 26/2/2026 14:27:54
; Author : crist

.include "M328PDEF.inc"
.equ	T1VALUE	= 0XE17B
.equ	MAX_MODES = 3
.def	MODE	= R20
.def	COUNTER = R21
.def	ACTION = R22




.cseg
.org 0x0000
	JMP START
.org PCI2addr
	JMP PIND_ISR
.org 
	JMP TMR1_ISR

SETUP:
	
	CLI 

	LDI		R16, (1 << CLKPCE)
	STS		CLPR, R16 
	LDI		R16, (1 << CLKPS2)
	STS		CLPR, R16












	SBI		DDRB, DDB0
	SBI		DDRB, DDB1
	CBI		PORTB, PORTB0
	CBI		PORTB, PORT1
	SBI		DDRC, DDC0
	SBI		DDRC, DDC1
	SBI		DDRC, DDC2
	SBI		DDRC, DDC3
	CBI		PORTC, PORTC0
	CBI		PORTC, PORTC1
	CBI		PORTC, PORTC2
	CBI		PORTC, PORTC3

	CBI		DDRD, DDD2
	CBI		DDRD, DDD3
	SBI		PORTD, PORTD2
	SBI		PORTD, PORTD3

	CALL	INIT_TMR1


	CLR		MODE
	CLR		COUNTER
	CLR		ACTION

	LDI		R16, (1 << TOIE1)
	STS		TIMSK1, R16




	SEI
MAIN_LOOP:
	OUT		PORTC, COUNTER
	RJMP MAIN_LOOP
INIT_TMR1:
	LDI		R16, 0x00
	STS		TCCR1, R16
	LDI		R16, (1 << CS11) | (1<< CS10)
	STS		TCCR1B, R16
	LDI		R16, HIGH(T1VALUE)
	STS		TCNT1H, R16
	LDI		R16, LOW(T1VALUE)
	STS		TCNT1L, R16
	RET

TMR1_ISR
	INC		COUNTER
	ANDI	COUNTER, 0X0F
	LDI		R16, HIGH(T1VALUE)
	STS		TCNT1H, R16
	LDI		R16, LOW(T1VALUE)
	STS		TCNT1L, R16
	RETI


